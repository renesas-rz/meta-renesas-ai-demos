## meta-ai-demos-common/conf/layer.conf
```bitbake
#We have a conf and classes directory, append to BBPATH
BBPATH .= ":${LAYERDIR}"

# We have a recipes directory, add to BBFILES
BBFILES += " \
        ${LAYERDIR}/recipes-*/*/*.bb \
        ${LAYERDIR}/recipes-*/*/*.bbappend \
"

BBFILE_COLLECTIONS += "meta-ai-demos-common-layer"
BBFILE_PATTERN_meta-ai-demos-common-layer := "^${LAYERDIR}/"
BBFILE_PRIORITY_meta-ai-demos-common-layer = "9"
```

## meta-demos-desktop-common/conf/layer.conf
```bitbake
#We have a conf and classes directory, append to BBPATH
BBPATH .= ":${LAYERDIR}"

# We have a recipes directory, add to BBFILES
BBFILES += " \
        ${LAYERDIR}/recipes-*/*/*.bb \
        ${LAYERDIR}/recipes-*/*/*.bbappend \
"

BBFILE_COLLECTIONS += "meta-demos-desktop-common-layer"
BBFILE_PATTERN_meta-demos-desktop-common-layer := "^${LAYERDIR}/"
BBFILE_PRIORITY_meta-demos-desktop-common-layer = "9"
```

## meta-object-detection-demo/conf/layer.conf
```bitbake
#We have a conf and classes directory, append to BBPATH
BBPATH .= ":${LAYERDIR}"

# We have a recipes directory, add to BBFILES
BBFILES += " \
        ${LAYERDIR}/recipes-*/*/*.bb \
        ${LAYERDIR}/recipes-*/*/*.bbappend \
"

BBFILE_COLLECTIONS += "object-detection-demo-layer"
BBFILE_PATTERN_object-detection-demo-layer := "^${LAYERDIR}/"
BBFILE_PRIORITY_object-detection-demo-layer = "10"
```

## meta-shopping-basket-demo/conf/layer.conf
```bitbake
#We have a conf and classes directory, append to BBPATH
BBPATH .= ":${LAYERDIR}"

# We have a recipes directory, add to BBFILES
BBFILES += " \
        ${LAYERDIR}/recipes-*/*/*.bb \
        ${LAYERDIR}/recipes-*/*/*.bbappend \
"

BBFILE_COLLECTIONS += "shopping-basket-demo-layer"
BBFILE_PATTERN_shopping-basket-demo-layer := "^${LAYERDIR}/"
BBFILE_PRIORITY_shopping-basket-demo-layer = "10"
LAYERSERIES_COMPAT_shopping-basket-demo-layer = "rocko dunfell"
PREFERRED_VERSION_opencv = "4.1.0-RZ"
PREFERRED_VERSION_ade = "0.1.1f-RZ"
```
